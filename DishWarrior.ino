#include <Chrono.h>
#include <LightChrono.h>

#include <MsTimer2.h>

#include <U8glib.h>

#include <avr/wdt.h>

// Dish Warrior
//
// lordzurp - 01-2019

// Appel des bibliothèques
  #include <Wire.h>
  //#include <Bounce2.h>
  #include <DishWarrior.h>
  
  #define ADRESSE_I2C_RTC 0x68
  U8GLIB_SSD1306_128X64 u8g(U8G_I2C_OPT_DEV_0|U8G_I2C_OPT_NO_ACK|U8G_I2C_OPT_FAST); // Fast I2C / TWI 

// Entrées
  entree pressostat   (2, "pressostat",     INPUT);
  entree therm_50     (3, "thermostat 50",  INPUT_PULLUP);
  entree therm_65     (4, "thermostat 65",  INPUT_PULLUP);
  entree start_bouton (5, "start engine",   INPUT_PULLUP);
// sorties
  sortie EV_eau     (8,  "EV eau");                 // Electrovanne entrée eau
  sortie M_cuve     (9,  "Moteur cuve");            // moteur remplissage cuve
  sortie M_cycle    (10, "Moteur cycle");           // moteur cycle
  sortie Chauffe    (11, "Resistance de chauffe");  // résistance chauffe
  sortie M_vidange  (12, "Moteur vidange");         // moteur vidange
  sortie blink_LED  (LED_BUILTIN, "heartbeat_LED"); // LED intégrée
// Etapes
  etape vidange             (0,10,0,     "vidange",      "de l'eau");
  etape remplissage         (0,10,0,    "remplissage",  "de la cuve");
  etape cycle_lavage        (10,0,60,    "lavage",       "en cours");
  etape cycle_rincage_court (120,0,15,   "rincage",      "court");
  etape cycle_rincage_long  (10,0,15,    "rincage",      "long");
  etape regen               (10,0,1,     "regeneration", "en cours");

// Chronos
  Chrono page_change(Chrono::SECONDS);
  Chrono menu_timeout(Chrono::SECONDS);
  Chrono screen_refresh(Chrono::MILLIS);

// Variables
  long previous_draw_time = 0;
  bool push_button = 0;
  bool push_court = 0;
  bool push_long = 0;
  bool push_confirm = 0;
  
  int current_etape = 0;
  String etape_desc_1 = " Let's go";
  String etape_desc_2 = " washing !";

  bool cycle_programme = 0;
  bool cycle_run = 0;
  bool cycle_pause = 0;
  bool cycle_termine = 0;
  bool cycle_annule = 0;

  bool menu_1 = 0;
  bool menu_2 = 0;

  bool depart_15 = 0;
  bool depart_20 = 0;
  bool depart_02 = 0;

  bool cycle_intensif = 0;
  bool cycle_eco = 0;
  bool cycle_rincage = 0;

  int page = 1; // la page à afficher, on swipe toutes les 5 secondes
  int page_menu = 1;

  byte varCompteur = 0; // La variable compteur

// time variables
  byte seconde, minute, heure;
  long current_time = 0;
  long previous_heartbeat_time = 0;
  long previous_pageswipe_time = 0;

  long push_time = 0;
  long push_start_time = 0;
  long in_menu = 0;

// calcul du temps de cycle du lavage
  long debut_cycle = 0;
  int duree_cycle = 120;
  int restant_cycle = 0;

// logos
  // dish washer - 40x42px
  const uint8_t dish_bitmap[] U8G_PROGMEM = {
    0x3f,0xff,0xff,0xff,0xfc,0x7f,0xff,0xff,0xff,0xfe,0xff,0xff,0xff,0xff,0xff,0xff,0xff,0xff,0xff,
    0xff,0xf0,0x00,0x00,0x00,0x0f,0xf0,0xc7,0x18,0x00,0x0f,0xf1,0xef,0xbc,0x00,0x0f,0xf1,0xef,0xbc,
    0x00,0x0f,0xf0,0xc7,0x18,0x00,0x0f,0xf0,0x00,0x00,0x00,0x0f,0xff,0xff,0xff,0xff,0xff,0xff,0xff,
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    0xff,0xff,0xff,0xff,0xff,0x7f,0xff,0xff,0xff,0xfe,0x3f,0xff,0xff,0xff,0xfc,0x1e,0x00,0x00,0x00,
    0x78
  };

  // 'insert_coin_1', 96x42px
  const uint8_t insert_coin_1[] U8G_PROGMEM = {
    0x3f,0xff,0xff,0xff,0xfc,0x0,0x0,0x0,0x0,0x0,0x0,0x0,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0xe0,
    0xf0,0xc6,0x30,0x0,0xf,0x0,0x3f,0xff,0x0,0x0,0x7,0xfc,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0xe,
    0xff,0xff,0xfc,0xfc,0xff,0xc,0x0,0xe0,0x30,0x0,0x0,0xe,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0xe,
    0xf0,0x0,0x3c,0x7c,0x3f,0x6,0x0,0x3f,0xff,0xf8,0x0,0xe,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0xe,
    0xff,0xcf,0xfc,0x7c,0x3f,0x0,0x3,0x0,0xc1,0xff,0x0,0xe,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0x0,
    0x3f,0xff,0xff,0xff,0xfc,0x0,0x0,0x0,0x0,0x0,0x0,0x0,0x1e,0x0,0x0,0x0,0x78,0x0,0x0,0x0,0x0,0x0,0x0,0x0
  };

  // 'insert_coin_2', 96x42px
  const uint8_t insert_coin_2[] U8G_PROGMEM = {
    0x3f,0xff,0xff,0xff,0xfc,0x0,0x0,0x0,0x0,0x0,0x0,0x0,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0x0,
    0xf0,0xc6,0x30,0x0,0xf,0x3,0xff,0xf0,0x0,0x0,0x7f,0xc0,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0xe3,
    0xff,0xff,0xfc,0xfc,0xff,0xc0,0xe,0x3,0x0,0x0,0x0,0xe3,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0xe3,
    0xf0,0x0,0x3c,0x7c,0x3f,0x60,0x3,0xff,0xff,0x80,0x0,0xe3,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0xe3,
    0xff,0xcf,0xfc,0x7c,0x3f,0x0,0x30,0xc,0x1f,0xf0,0x0,0xe3,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0x0,
    0x3f,0xff,0xff,0xff,0xfc,0x0,0x0,0x0,0x0,0x0,0x0,0x0,0x1e,0x0,0x0,0x0,0x78,0x0,0x0,0x0,0x0,0x0,0x0,0x0
  };

  // 'insert_coin_3', 96x42px
  const uint8_t insert_coin_3[] U8G_PROGMEM = {
    0x3f,0xff,0xff,0xff,0xfc,0x0,0x0,0x0,0x0,0x0,0x0,0x0,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0x0,
    0xf0,0xc6,0x30,0x0,0xf,0xff,0xf8,0x0,0x0,0x3f,0xe0,0x0,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0xfe,
    0xff,0xff,0xfc,0xfc,0xff,0x7,0x0,0x0,0x0,0x0,0x71,0xfe,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0xfe,
    0xf0,0x0,0x3c,0x7c,0x3f,0x1,0xff,0xff,0xc0,0x0,0x71,0xfe,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0xfe,
    0xff,0xcf,0xfc,0x7c,0x3f,0x18,0x6,0xf,0xf8,0x0,0x71,0xfe,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0x0,
    0x3f,0xff,0xff,0xff,0xfc,0x0,0x0,0x0,0x0,0x0,0x0,0x0,0x1e,0x0,0x0,0x0,0x78,0x0,0x0,0x0,0x0,0x0,0x0,0x0
  };

  // Rick, 64x44px
  const uint8_t rick[] U8G_PROGMEM = {
    0x0,0x0,0x3,0xc0,0x0,0x8,0x0,0x0,0x0,0x0,0x3,0xe0,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0xc0,
    0x1,0xfe,0x7,0xff,0xff,0xf8,0x7,0xc0,0x1,0xff,0xff,0xff,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0x0,
    0x0,0x7,0xfc,0x0,0x0,0x3f,0xfc,0x0,0x0,0x7,0xf8,0x0,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0x0,
    0x0,0xf,0xf7,0xfe,0x7f,0xef,0xe0,0x0,0x0,0x1f,0xf4,0x62,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0x0,
    0x0,0x1f,0xf0,0x2,0x40,0xf,0xfc,0x0,0x0,0x3f,0xf0,0x2,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0x0,
    0x0,0x0,0x6,0x0,0x50,0xe0,0x0,0x0,0x0,0x0,0x3,0x80,0x63,0x80,0x0,0x0,0x0,0x0,0x0,0xe0,0xe,0x0,0x0,0x0,0x0,0x0,0x0,0x3f,0xf8,0x0,0x0,0x0
  };

  // Morty, 64x44px
  const uint8_t morty[] U8G_PROGMEM = {
    0x00, 0x00, 0x03, 0xff, 0xf8, 0x00, 0x00, 0x00, 0x00, 0x00, 0x1f, 0xff, 0xfc, 0x00, 0x00, 0x00, 
    0x00, 0x01, 0xff, 0xff, 0xff, 0x80, 0x00, 0x00, 0x00, 0x07, 0xff, 0xff, 0xff, 0xf0, 0x00, 0x00, 
    0x00, 0x0f, 0xff, 0xff, 0xff, 0xf8, 0x00, 0x00, 0x00, 0x1f, 0xff, 0xff, 0xff, 0xfe, 0x00, 0x00, 
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    0x00, 0x00, 0x0e, 0x00, 0x00, 0x01, 0xc0, 0x00, 0x00, 0x00, 0x03, 0xc0, 0x00, 0x07, 0x00, 0x00
  };

void setup() {
  Wire.begin();
  //Serial.begin(9600);

  MsTimer2::set(1000,heartbeat);
  MsTimer2::start();

  // init carte relais
  reinit();
//  wdt_enable(WDTO_8S);
}

void loop() {

//wdt_reset();

  // on init le timestamp initial de la boucle
  current_time = millis();

  start_bouton.update();
  pressostat.update();
  therm_65.update();
  therm_50.update();

  push_court = 0;
  push_long = 0;
  push_confirm = 0;

  if (start_bouton.state && !push_button) {
    push_button = 1;
    push_start_time = current_time;
  }

  if (start_bouton.state && push_button) {
    push_time = current_time - push_start_time;
    if (push_time > 2000) {
      push_confirm = 1;
    }
  }

  if (!start_bouton.state && push_button) {
    push_time = current_time - push_start_time;
    if (push_time > 50) {
      push_button = 0;
      if ( (push_time > 100 && push_time < 1000) && !cycle_run) {
        push_court = 1;
      }
      if ((push_time > 1000 && push_time < 5000) && !cycle_run) {
        push_long = 1;
        push_confirm = 0;
      }
    }
  }

  if (push_court) {
    if (cycle_run) {
      if (cycle_pause) 
        cycle_pause = 0;
      else {
        cycle_pause = 1;
        stop_all();
      }
    }
    else {
      if (!menu_1 && !menu_2) {
        menu_1 = 1;
        in_menu = current_time;
      }
      else 
        page_menu++;
    }
  }

if (push_long) {
  if (menu_1) {
    switch (page_menu) {
      case 1:
        // depart immediat
        cycle_run = 1;
        menu_1 = 0;
        menu_2 = 0;
        page_menu = 1;
        break;
      case 2:
        // depart à 15h
        depart_15 = 1;
        depart_20 = 0;
        depart_02 = 0;
        menu_1 = 0;
        menu_2 = 0;
        page_menu = 1;
        page = 1;
        break;
      case 3:
        // depart à 20h30
        depart_15 = 0;
        depart_20 = 1;
        depart_02 = 0;
        menu_1 = 0;
        menu_2 = 0;
        page_menu = 1;
        page = 1;
        break;
      case 4:
        // depart à 02h30
        depart_15 = 0;
        depart_20 = 0;
        depart_02 = 1;
        menu_1 = 0;
        menu_2 = 0;
        page_menu = 1;
        page = 1;
        break;
      case 5:
        menu_1 = 0;
        menu_2 = 1;
        page_menu = 1;
        in_menu = current_time;
        break;
      default:
        // do something
        break;
    }
  }
  else if (menu_2) {
    switch (page_menu) {
      case 1:
        menu_1 = 0;
        menu_2 = 0;
        page_menu = 1;
        break;
      case 2:
        // lavage intensif
        cycle_intensif = 1;
        menu_1 = 0;
        menu_2 = 0;
        page_menu = 1;
        break;
      case 3:
        // lavage eco
        cycle_eco = 1;
        menu_1 = 0;
        menu_2 = 0;
        page_menu = 1;
        break;
      case 4:
        // rincage seulement
        cycle_rincage = 1;
        current_etape = 7;
        menu_1 = 0;
        menu_2 = 0;
        page_menu = 1;
        break;
      case 5:
        menu_1 = 1;
        menu_2 = 0;
        page_menu = 1;
        break;
      default:
        // do something
        break;
    }
  }
}

  if (cycle_run && !cycle_pause) {
    switch (current_etape) {
      case 0:
        reinit_cycle();
        debut_cycle = millis();
        current_etape++;
        page = 1;
        break;
      case 1: // on commence par vidanger le LV
        vidange.run();
        if (vidange.running) {
          M_vidange.start();
          if ( pressostat.state )
            vidange.done = 1;
        }
        else {
          M_vidange.stop();
        }
        break;
      case 2: // on remplit le LV
      //delay(3000);
        remplissage.run();
        if (remplissage.running) {
          if (pressostat.state) {
            EV_eau.start();
          } 
          else {
            remplissage.done = 1;
          }
        }
        else {
          EV_eau.stop();
        }
        break;
      case 3: // on lance le cycle de lavage
        cycle_lavage.run();
        if (cycle_lavage.running) {
          M_cycle.start();
          if ( ( !cycle_eco && !therm_65.state ) || (cycle_eco && !therm_50.state) || cycle_intensif )
            Chauffe.start();
          else
            Chauffe.stop();
        }
        else {
          Chauffe.stop();
          M_cycle.stop();
        }
        break;
      case 4: // on vidange l'eau sale
        vidange.run();
        if (vidange.running) {
          M_vidange.start();
          if (pressostat.state)
            vidange.done = 1;
        }
        else {
          M_vidange.stop();
        }
        break;
      case 5: // on remplit le LV
        remplissage.run();
        if (remplissage.running) {
          if (pressostat.state) {
            EV_eau.start();
          } 
          else {
            remplissage.done = 1;
          }
        }
        else {
          EV_eau.stop();
        }
        break;
      case 6: // on rince 1 fois
        cycle_rincage_court.run();
        if (cycle_rincage_court.running) {
          M_cycle.start();
          if (!therm_50.state)
            Chauffe.start();
          else
            Chauffe.stop();
        }
        else {
          Chauffe.stop();
          M_cycle.stop();
        }
        break;
      case 7: // on vidange encore
        vidange.run();
        if (vidange.running) {
          M_vidange.start();
          if (pressostat.state)
            vidange.done = 1;
        }
        else {
          M_vidange.stop();
        }
        break;
      case 8: // on remplit le LV
        remplissage.run();
        if (remplissage.running) {
          if (pressostat.state) {
            EV_eau.start();
          } 
          else {
            remplissage.done = 1;
          }
        }
        else {
          EV_eau.stop();
        }
        break;
      case 9: // on rince 2 fois
        cycle_rincage_long.run();
        if (cycle_rincage_long.running) {
          M_cycle.start();
          if (!therm_50.state)
            Chauffe.start();
          else
            Chauffe.stop();
        }
        else {
          Chauffe.stop();
          M_cycle.stop();
        }
        break;
      case 10: // on vidange encore
        vidange.run();
        if (vidange.running) {
          M_vidange.start();
          if (pressostat.state)
            vidange.done = 1;
        }
        else {
          M_vidange.stop();
        }
        break;
      case 11: // on remplit le LV
        remplissage.run();
        if (remplissage.running) {
          if (pressostat.state) {
            EV_eau.start();
          } 
          else {
            remplissage.done = 1;
          }
        }
        else {
          EV_eau.stop();
        }
        break;
      case 12: // on rince 3 fois
        cycle_rincage_long.run();
        if (cycle_rincage_long.running) {
          M_cycle.start();
          if (!therm_50.state)
            Chauffe.start();
          else
            Chauffe.stop();
        }
        else {
          Chauffe.stop();
          M_cycle.stop();
        }
        break;
      case 13: // on vidange encore
        vidange.run();
        if (vidange.running) {
          M_vidange.start();
          if (pressostat.state)
            vidange.done = 1;
        }
        else {
          M_vidange.stop();
        }
        break;
      case 14: // on régenere la résine
        regen.run();
        if (regen.running) {
          M_cuve.start();
          M_vidange.start();
        }
        else {
          M_cuve.stop();
          M_vidange.stop();
        }
        break;
      case 15: // sechage
        etape_desc_1 = "Sechage";
        etape_desc_2 = "en cours";
        if (restant_cycle <= 0)
          current_etape++;
        break;
      default: // si on sort des clous, on reset tout
        reinit();
        cycle_termine = 1;
        break;
    }
    restant_cycle = duree_cycle - ((current_time - debut_cycle) / 1000 / 60);
  }

  if (screen_refresh.hasPassed(100,1)) {
    lire_date();
    u8g.firstPage();
    do {
      draw();
    } while( u8g.nextPage() );
    previous_draw_time = millis();
  }

/*  if (current_time - previous_pageswipe_time >= 5000) {
    previous_pageswipe_time = millis();
    page++;
  }*/
  
  if (page_change.hasPassed(5,1)) {
    page++;
  }

  if (menu_timeout.hasPassed(15,1)) {
    menu_1 = 0;
    menu_2 = 0;
    page_menu = 1;
  }

  if (depart_15 && heure == 15 && minute == 7) {
    cycle_run = 1;
    depart_15 = 0;
  }
  if (depart_20 && heure == 20 && minute == 37) {
    cycle_run = 1;
    depart_20 = 0;
  }
  if (depart_02 && heure == 2 && minute == 37) {
    cycle_run = 1;
    depart_02 = 0;
  }
}


